## CMakeLists.txt
```
cmake_minimum_required(VERSION 3.20.0)
find_package(Zephyr REQUIRED HINTS $ENV{ZEPHYR_BASE})

project(umbreon_unit_tests)

# ── Production source files under test ────────────────────────────────────────
# Only include files whose logic we actually test.
# Hardware-heavy files (main.c, sensors.c, battery.c, control.c) are excluded —
# their testable logic is extracted into stubs or tested indirectly.

set(APP_SRC ${CMAKE_CURRENT_SOURCE_DIR}/../../src)

target_sources(app PRIVATE
    src/main.c
    src/test_cyc_delta.c
    src/test_map_val.c
    src/test_parse_set.c
    src/test_speed.c
)

# ── Expose static functions for testing ───────────────────────────────────────
target_compile_definitions(app PRIVATE UNIT_TEST=1)

# ── Include production headers ────────────────────────────────────────────────
target_include_directories(app PRIVATE
    ${APP_SRC}
    src
)
```

## prj.conf
```kconfig
# ── Umbreon ztest unit tests ──────────────────────────────────────────────────
CONFIG_ZTEST=y
CONFIG_ZTEST_ASSERT_VERBOSE=1
```

## src/main.c
```c
/*
 * main.c — ztest entry point
 *
 * The cfg instance lives here; individual test files are separate .c files.
 */

#include "test_common.h"

struct car_settings cfg;
```

## src/test_common.h
```c
/*
 * test_common.h — Shared helpers for ztest unit tests
 *
 * Extracted copies of static inline functions from production code.
 * When source changes — update these or expose originals via #ifdef UNIT_TEST.
 */
#pragma once

#include <zephyr/kernel.h>
#include <zephyr/ztest.h>
#include <math.h>
#include <string.h>
#include <stdlib.h>

#ifndef M_PI
#define M_PI 3.14159265358979323846
#endif

/* ─── From tachometer.c:37-41 ─────────────────────────────────────────────── */
static inline uint32_t cyc_delta_us(uint32_t from_cyc, uint32_t to_cyc)
{
	uint32_t delta_cyc = to_cyc - from_cyc;
	return (uint32_t)k_cyc_to_us_floor64(delta_cyc);
}

/* ─── From car.c:49-52 ────────────────────────────────────────────────────── */
static inline int map_val(int x, int in_min, int in_max, int out_min, int out_max)
{
	return (x - in_min) * (out_max - out_min) / (in_max - in_min) + out_min;
}

/* ─── Speed formula from tachometer.c:100-101 (extracted, no atomics) ─────── */
static inline float speed_formula(float wheel_diam_m, int encoder_holes,
				  uint32_t elapsed_us)
{
	if (elapsed_us == 0 || elapsed_us > 500000 || encoder_holes <= 0) {
		return 0.0f;
	}
	return ((float)M_PI * wheel_diam_m) /
	       ((float)encoder_holes * ((float)elapsed_us / 1e6f));
}

/* ─── cfg struct (from settings.h) ────────────────────────────────────────── */
#define SENSOR_COUNT     6
#define MAX_SENSOR_RANGE 2000
#define NEUTRAL_SPEED    1500

struct car_settings {
	int front_obstacle_dist;
	int side_open_dist;
	int all_close_dist;
	int close_front_dist;
	float pid_kp;
	float pid_ki;
	float pid_kd;
	int min_speed;
	int max_speed;
	int min_bspeed;
	int min_point;
	int max_point;
	int neutral_point;
	int encoder_holes;
	float wheel_diam_m;
	int loop_ms;
	float spd_clear;
	float spd_blocked;
	float spd_slew;
	float kick_pct;
	int kick_ms;
	float coe_clear;
	float coe_blocked;
	float wrong_dir_deg;
	bool race_cw;
	int stuck_thresh;
	bool imu_rotate;
	bool servo_reverse;
	bool calibrated;
	bool bat_enabled;
	float bat_multiplier;
	float bat_low;
};

/* Global cfg instance — tests reset it in before() */
extern struct car_settings cfg;

/* ─── From wifi_cmd.c:208-256 ─────────────────────────────────────────────── */
static inline bool parse_set_pair(const char *pair)
{
	const char *eq = strchr(pair, '=');
	if (!eq) {
		return false;
	}

	char key[8];
	int klen = eq - pair;
	if (klen <= 0 || klen >= (int)sizeof(key)) {
		return false;
	}
	memcpy(key, pair, klen);
	key[klen] = '\0';
	const char *val = eq + 1;

	if      (strcmp(key, "FOD")  == 0) cfg.front_obstacle_dist = CLAMP(atoi(val), 10, MAX_SENSOR_RANGE);
	else if (strcmp(key, "SOD")  == 0) cfg.side_open_dist      = CLAMP(atoi(val), 10, MAX_SENSOR_RANGE);
	else if (strcmp(key, "ACD")  == 0) cfg.all_close_dist      = CLAMP(atoi(val), 10, MAX_SENSOR_RANGE);
	else if (strcmp(key, "CFD")  == 0) cfg.close_front_dist    = CLAMP(atoi(val), 10, MAX_SENSOR_RANGE);
	else if (strcmp(key, "KP")   == 0) cfg.pid_kp              = strtof(val, NULL);
	else if (strcmp(key, "KI")   == 0) cfg.pid_ki              = strtof(val, NULL);
	else if (strcmp(key, "KD")   == 0) cfg.pid_kd              = strtof(val, NULL);
	else if (strcmp(key, "MSP")  == 0) cfg.min_speed           = CLAMP(atoi(val), 1000, 2000);
	else if (strcmp(key, "XSP")  == 0) cfg.max_speed           = CLAMP(atoi(val), 1000, 2000);
	else if (strcmp(key, "BSP")  == 0) cfg.min_bspeed          = CLAMP(atoi(val), 1000, 2000);
	else if (strcmp(key, "MNP")  == 0) cfg.min_point           = CLAMP(atoi(val), 0, 180);
	else if (strcmp(key, "XNP")  == 0) cfg.max_point           = CLAMP(atoi(val), 0, 180);
	else if (strcmp(key, "NTP")  == 0) cfg.neutral_point       = CLAMP(atoi(val), 0, 180);
	else if (strcmp(key, "ENH")  == 0) cfg.encoder_holes       = MAX(atoi(val), 1);
	else if (strcmp(key, "WDM")  == 0) cfg.wheel_diam_m        = strtof(val, NULL);
	else if (strcmp(key, "LMS")  == 0) cfg.loop_ms             = MAX(atoi(val), 10);
	else if (strcmp(key, "SPD1") == 0) cfg.spd_clear           = strtof(val, NULL);
	else if (strcmp(key, "SPD2") == 0) cfg.spd_blocked         = strtof(val, NULL);
	else if (strcmp(key, "SLW")  == 0) cfg.spd_slew           = strtof(val, NULL);
	else if (strcmp(key, "KOP")  == 0) cfg.kick_pct           = strtof(val, NULL);
	else if (strcmp(key, "KOM")  == 0) cfg.kick_ms            = MAX(atoi(val), 0);
	else if (strcmp(key, "COE1") == 0) cfg.coe_clear           = strtof(val, NULL);
	else if (strcmp(key, "COE2") == 0) cfg.coe_blocked         = strtof(val, NULL);
	else if (strcmp(key, "WDD")  == 0) cfg.wrong_dir_deg       = strtof(val, NULL);
	else if (strcmp(key, "RCW")  == 0) cfg.race_cw             = atoi(val) != 0;
	else if (strcmp(key, "STK")  == 0) cfg.stuck_thresh        = MAX(atoi(val), 0);
	else if (strcmp(key, "IMR")  == 0) cfg.imu_rotate          = atoi(val) != 0;
	else if (strcmp(key, "SVR")  == 0) cfg.servo_reverse       = atoi(val) != 0;
	else if (strcmp(key, "CAL")  == 0) cfg.calibrated          = atoi(val) != 0;
	else if (strcmp(key, "BEN")  == 0) cfg.bat_enabled         = atoi(val) != 0;
	else if (strcmp(key, "BML")  == 0) cfg.bat_multiplier      = strtof(val, NULL);
	else if (strcmp(key, "BLV")  == 0) cfg.bat_low             = strtof(val, NULL);
	else return false;

	return true;
}
```

## src/test_cyc_delta.c
```c
/*
 * test_cyc_delta.c — cyc_delta_us() wraparound math
 *
 * Tests use k_cyc_to_us_floor64() for expected values so they work on
 * any platform (native_sim = 1 MHz, RP2350 = 150 MHz).
 */

#include "test_common.h"

/* Helper: how many cycles make N microseconds on this platform */
#define US_TO_CYC(us) ((uint32_t)((uint64_t)(us) * \
	CONFIG_SYS_CLOCK_HW_CYCLES_PER_SEC / 1000000ULL))

ZTEST_SUITE(cyc_delta, NULL, NULL, NULL, NULL, NULL);

ZTEST(cyc_delta, test_normal)
{
	uint32_t cyc = US_TO_CYC(1);
	zassert_equal(cyc_delta_us(0, cyc), 1, "1 µs delta");
}

ZTEST(cyc_delta, test_larger)
{
	uint32_t cyc = US_TO_CYC(100);
	zassert_equal(cyc_delta_us(1000, 1000 + cyc), 100, "100 µs delta");
}

ZTEST(cyc_delta, test_one_ms)
{
	uint32_t cyc = US_TO_CYC(1000);
	zassert_equal(cyc_delta_us(0, cyc), 1000, "1 ms delta");
}

ZTEST(cyc_delta, test_zero)
{
	zassert_equal(cyc_delta_us(5000, 5000), 0, "zero delta");
}

ZTEST(cyc_delta, test_wraparound_small)
{
	/* Cycle counter wraps: from near-max to small value */
	uint32_t from = 0xFFFFFFF0U;
	uint32_t to   = from + US_TO_CYC(10);  /* 10 µs past wrap */
	zassert_equal(cyc_delta_us(from, to), 10, "wraparound 10 µs");
}

ZTEST(cyc_delta, test_wraparound_large)
{
	/* Wrap with ~5 ms past wrap point */
	uint32_t from = 0xFFFF0000U;
	uint32_t to   = from + US_TO_CYC(5000);
	zassert_equal(cyc_delta_us(from, to), 5000, "wraparound 5 ms");
}
```

## src/test_map_val.c
```c
/*
 * test_map_val.c — map_val() linear interpolation
 */

#include "test_common.h"

ZTEST_SUITE(map_val_suite, NULL, NULL, NULL, NULL, NULL);

ZTEST(map_val_suite, test_midpoint)
{
	zassert_equal(map_val(5, 0, 10, 0, 100), 50);
}

ZTEST(map_val_suite, test_min_boundary)
{
	zassert_equal(map_val(0, 0, 10, 0, 100), 0);
}

ZTEST(map_val_suite, test_max_boundary)
{
	zassert_equal(map_val(10, 0, 10, 0, 100), 100);
}

ZTEST(map_val_suite, test_reverse_output)
{
	zassert_equal(map_val(5, 0, 10, 100, 0), 50);
}

ZTEST(map_val_suite, test_negative_input)
{
	zassert_equal(map_val(0, -1000, 1000, 0, 180), 90);
}

ZTEST(map_val_suite, test_servo_realistic)
{
	zassert_equal(map_val(-1000, -1000, 1000, 30, 150), 30);
	zassert_equal(map_val(0,    -1000, 1000, 30, 150), 90);
	zassert_equal(map_val(1000, -1000, 1000, 30, 150), 150);
}

ZTEST(map_val_suite, test_esc_forward)
{
	zassert_equal(map_val(0,    0, 1000, 1500, 1800), 1500);
	zassert_equal(map_val(500,  0, 1000, 1500, 1800), 1650);
	zassert_equal(map_val(1000, 0, 1000, 1500, 1800), 1800);
}
```

## src/test_parse_set.c
```c
/*
 * test_parse_set.c — parse_set_pair() validation
 */

#include "test_common.h"

static void reset_cfg(void *arg)
{
	ARG_UNUSED(arg);
	memset(&cfg, 0, sizeof(cfg));
}

ZTEST_SUITE(parse_set, NULL, NULL, reset_cfg, NULL, NULL);

/* ── Valid inputs ─────────────────────────────────────────────────────────── */

ZTEST(parse_set, test_valid_int)
{
	zassert_true(parse_set_pair("FOD=800"));
	zassert_equal(cfg.front_obstacle_dist, 800);
}

ZTEST(parse_set, test_valid_float)
{
	zassert_true(parse_set_pair("KP=1.5"));
	zassert_true(fabsf(cfg.pid_kp - 1.5f) < 0.001f);
}

ZTEST(parse_set, test_valid_bool_true)
{
	zassert_true(parse_set_pair("RCW=1"));
	zassert_true(cfg.race_cw);
}

ZTEST(parse_set, test_valid_bool_false)
{
	cfg.race_cw = true;
	zassert_true(parse_set_pair("RCW=0"));
	zassert_false(cfg.race_cw);
}

ZTEST(parse_set, test_normal_values)
{
	zassert_true(parse_set_pair("LMS=40"));
	zassert_equal(cfg.loop_ms, 40);

	zassert_true(parse_set_pair("ENH=62"));
	zassert_equal(cfg.encoder_holes, 62);

	zassert_true(parse_set_pair("WDM=0.065"));
	zassert_true(fabsf(cfg.wheel_diam_m - 0.065f) < 0.001f);
}

/* ── Invalid inputs ───────────────────────────────────────────────────────── */

ZTEST(parse_set, test_no_equals)
{
	zassert_false(parse_set_pair("FOD800"));
}

ZTEST(parse_set, test_empty_key)
{
	zassert_false(parse_set_pair("=800"));
}

ZTEST(parse_set, test_key_too_long)
{
	zassert_false(parse_set_pair("TOOLONGKEY=800"));
}

ZTEST(parse_set, test_unknown_key)
{
	zassert_false(parse_set_pair("ZZZ=123"));
}

/* ── CLAMP validation ─────────────────────────────────────────────────────── */

ZTEST(parse_set, test_lms_clamped_to_10)
{
	zassert_true(parse_set_pair("LMS=0"));
	zassert_equal(cfg.loop_ms, 10);
}

ZTEST(parse_set, test_lms_negative_clamped)
{
	zassert_true(parse_set_pair("LMS=-5"));
	zassert_equal(cfg.loop_ms, 10);
}

ZTEST(parse_set, test_enh_clamped_to_1)
{
	zassert_true(parse_set_pair("ENH=0"));
	zassert_equal(cfg.encoder_holes, 1);
}

ZTEST(parse_set, test_fod_clamped_low)
{
	zassert_true(parse_set_pair("FOD=1"));
	zassert_equal(cfg.front_obstacle_dist, 10);
}

ZTEST(parse_set, test_fod_clamped_high)
{
	zassert_true(parse_set_pair("FOD=9999"));
	zassert_equal(cfg.front_obstacle_dist, MAX_SENSOR_RANGE);
}

ZTEST(parse_set, test_esc_clamped)
{
	zassert_true(parse_set_pair("MSP=500"));
	zassert_equal(cfg.min_speed, 1000);

	zassert_true(parse_set_pair("XSP=3000"));
	zassert_equal(cfg.max_speed, 2000);
}

ZTEST(parse_set, test_servo_clamped)
{
	zassert_true(parse_set_pair("MNP=999"));
	zassert_equal(cfg.min_point, 180);

	zassert_true(parse_set_pair("XNP=-10"));
	zassert_equal(cfg.max_point, 0);
}
```

## src/test_speed.c
```c
/*
 * test_speed.c — taho_get_speed() core math (speed_formula)
 */

#include "test_common.h"

#define WHEEL_DIAM 0.065f
#define ENC_HOLES  62

ZTEST_SUITE(speed, NULL, NULL, NULL, NULL, NULL);

ZTEST(speed, test_stationary)
{
	/* elapsed > 500 ms → wheel stopped */
	zassert_true(speed_formula(WHEEL_DIAM, ENC_HOLES, 600000) == 0.0f);
}

ZTEST(speed, test_zero_interval)
{
	zassert_true(speed_formula(WHEEL_DIAM, ENC_HOLES, 0) == 0.0f);
}

ZTEST(speed, test_zero_encoder_holes)
{
	zassert_true(speed_formula(WHEEL_DIAM, 0, 1000) == 0.0f);
}

ZTEST(speed, test_negative_encoder_holes)
{
	zassert_true(speed_formula(WHEEL_DIAM, -1, 1000) == 0.0f);
}

ZTEST(speed, test_one_ms)
{
	/* ~1 m/s: elapsed ≈ 3300 µs
	 * speed = π×0.065 / (62 × 0.0033) ≈ 0.998 m/s */
	float spd = speed_formula(WHEEL_DIAM, ENC_HOLES, 3300);

	zassert_true(fabsf(spd - 0.998f) < 0.01f,
		     "expected ~0.998, got %f", (double)spd);
}

ZTEST(speed, test_three_ms)
{
	/* ~3 m/s: elapsed ≈ 1100 µs */
	float spd = speed_formula(WHEEL_DIAM, ENC_HOLES, 1100);

	zassert_true(fabsf(spd - 2.994f) < 0.02f,
		     "expected ~2.994, got %f", (double)spd);
}

ZTEST(speed, test_just_under_cutoff)
{
	/* 490 ms — just under 500 ms cutoff, should still read */
	float spd = speed_formula(WHEEL_DIAM, ENC_HOLES, 490000);

	zassert_true(spd > 0.0f, "should report nonzero speed");
	zassert_true(spd < 0.01f, "should be very slow");
}
```
