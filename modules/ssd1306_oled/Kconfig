## modules/ssd1306_oled/Kconfig
```kconfig
menuconfig SSD1306_OLED
	bool "SSD1306 OLED custom display driver"
	default y
	depends on DT_HAS_SOLOMON_SSD1306FB_ENABLED
	depends on I2C
	help
	  Custom SSD1306 I2C display driver with Arduino-proven init
	  sequence (Adafruit SSD1306). Replaces stock CONFIG_SSD1306.
	  Implements standard Zephyr display_driver_api for CFB compatibility.

if SSD1306_OLED

config SSD1306_OLED_DEFAULT_CONTRAST
	int "Default contrast (0-255)"
	default 207
	help
	  Default contrast level. 207 (0xCF) matches Adafruit's default
	  for 128x64 displays with internal VCC.

endif # SSD1306_OLED
```

## modules/vl53l0x_enhanced/Kconfig
```kconfig
menuconfig VL53L0X_ENHANCED
	bool "VL53L0X Enhanced ToF sensor driver"
	default y
	depends on DT_HAS_ST_VL53L0X_ENABLED
	depends on I2C
	help
	  Enhanced VL53L0X driver with continuous measurement mode,
	  configurable timing budget, measurement profiles, and
	  full ST HAL access via standard Zephyr sensor API.

	  Replaces the stock st,vl53l0x driver. Set CONFIG_VL53L0X=n
	  when using this driver.

if VL53L0X_ENHANCED

config VL53L0X_ENHANCED_RECONFIGURE_ADDRESS
	bool "Reconfigure I2C address at runtime"
	default y
	help
	  Enable runtime reconfiguration of the sensor I2C address
	  using XSHUT GPIO. Required for multi-sensor setups where
	  each sensor must have a unique bus address.

config VL53L0X_ENHANCED_PROXIMITY_THRESHOLD
	int "Proximity threshold in millimeters"
	default 100
	help
	  Distance threshold for the SENSOR_CHAN_PROX channel.
	  Values at or below this threshold report proximity = 1.

config VL53L0X_ENHANCED_ST_POLLING_DELAY_MS
	int "ST HAL VL53L0X_PollingDelay duration (ms), 0 disables"
	default 2
	range 0 10
	help
	  ST API calls this from single-shot completion loops, device reset,
	  and init paths (e.g. get_info_from_device). Continuous read uses
	  GetMeasurementDataReady + GetRangingMeasurementData and does not
	  poll in a tight loop. Set to 0 to skip sleeping in polling hooks
	  (less blocking; may stress I2C on some init paths).

endif # VL53L0X_ENHANCED
```
