## modules/u8g2_zephyr/Kconfig
```kconfig
menuconfig U8G2
	bool "U8G2 monochrome graphics library"
	default n
	depends on I2C
	help
	  Compiles a curated subset of u8g2 sources for SSD1306 128x64
	  over I2C. Communicates directly with the hardware, bypassing the
	  Zephyr display subsystem. Incompatible with CONFIG_SSD1306=y,
	  CONFIG_DISPLAY=y, and CONFIG_CHARACTER_FRAMEBUFFER=y.
```
